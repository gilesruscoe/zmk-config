/*
 * ZMK Matrix Transform for a 4-key handwired micropad
 * Assumes direct wiring (no rows/columns)
 */

#include <dt-bindings/gpio/gpio.h> // Needed for GPIO_ACTIVE_LOW
#include <dt-bindings/zmk/matrix_transform.h> // Needed for matrix_transform

/ { // Start of root node

  chosen {
		zmk,kscan = &default_kscan;
		zmk,matrix_transform = &default_transform;



	};

    // Define the kscan node for direct GPIO inputs
    default_kscan: kscan {
        compatible = "zmk,kscan-gpio-direct"; // *** CORRECT compatible string ***
        label = "default_kscan";

        // Define the list of GPIOs connected directly to keys.
        // The order determines the key index (0, 1, 2, 3 in this case).
        // IMPORTANT: Replace the pin numbers (2, 3, 4, 5 below) with the actual
        // Pro Micro / Nice!Nano pin numbers (e.g., D2 is 2, D3 is 3, B5 is 9)
        // that you connected your keys to.
        // Use (GPIO_ACTIVE_LOW | GPIO_PULL_UP) if keys connect pin to GND when pressed.
        input-gpios = <&pro_micro 19 (GPIO_ACTIVE_HIGH | GPIO_PULL_DOWN)>
              , <&pro_micro 18 (GPIO_ACTIVE_HIGH | GPIO_PULL_DOWN)>
              , <&pro_micro 15 (GPIO_ACTIVE_HIGH | GPIO_PULL_DOWN)>
              , <&pro_micro 14 (GPIO_ACTIVE_HIGH | GPIO_PULL_DOWN)>
              ;
    }; // End of kscan node
};