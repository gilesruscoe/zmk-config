/* micropad.keymap */
#include <behaviors.dtsi>
#include <dt-bindings/zmk/keys.h>
#include <dt-bindings/zmk/bt.h> // Include if using Bluetooth commands

/ {
    keymap {
        compatible = "zmk,keymap";

        default_layer {
            // Map based on the index order in your micropad_hw.overlay map
            //        Key 0  Key 1  Key 2  Key 3
            bindings = <
                &kp A    &kp B    &kp C    &kp D
            >;
        };

        // Add more layers if needed (e.g., for macros, media keys)
        /*
        layer_1 {
            bindings = <
                &kp N1   &kp N2   &kp N3   &kp N4
            >;
        };
        */
    };
};