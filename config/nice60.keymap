#include <behaviors.dtsi>
#include <dt-bindings/zmk/keys.h>

/ {
    keymap {
        compatible = "zmk,keymap";

        default_layer { // Layer 0
            display-name = "Base";
            bindings = <
                &kp W    &kp A    &kp S    &kp D
            >;
        };
    };
};
